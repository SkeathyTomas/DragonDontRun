#include <Servo.h>
Servo myservo;  // create servo object to control a servo
int angle = 0;    // variable to store the servo position
/*设置每个按键的输入端口号*/
int inputbis = 10;
int inputbag = 9;
int inputstring = 8;
/*设置蜂鸣器输出端口号*/  
int BuzzerPin = 3; 
int fsrPin = 0;     // A0 接口
int fsrReading;

void setup() {
  Serial.begin(9600);
  myservo.attach(13);
/*设置输入输出端口*/
  pinMode(inputbis, INPUT);
  pinMode(inputbag, INPUT);
  pinMode(inputstring, INPUT);
  
  pinMode(BuzzerPin, OUTPUT);
}
 
void loop() {
/*读取端口值到val* */ 
int valC = digitalRead(inputbis); 
int valD = digitalRead(inputbag); 
int valE = digitalRead(inputstring); 
digitalWrite(BuzzerPin, LOW);
/*按键是否按下 val*，若按下 发声*/
if (valC == HIGH){
/*发出音*/
  digitalWrite(BuzzerPin, HIGH);
  delayMicroseconds(1915);
  digitalWrite(BuzzerPin, LOW);
  delayMicroseconds(1915);
  }
else if (valD == HIGH){

  }
else if (valE == HIGH){
  /*发出音*/
  digitalWrite(BuzzerPin, HIGH);
  delayMicroseconds(1915);
  digitalWrite(BuzzerPin, LOW);
  delayMicroseconds(1915);
  }
/*不发音*/
 else digitalWrite(BuzzerPin, LOW);  
 if(valD == LOW){
  fsrReading = analogRead(fsrPin);
  if (fsrReading > 1) {
    Serial.println("heavey");
  }else Serial.println("empty");
  angle = 0;
  myservo.write(angle);
 }
 else{ 
 Serial.println("turn");
 angle = 150;
 myservo.write(angle);
 }
}